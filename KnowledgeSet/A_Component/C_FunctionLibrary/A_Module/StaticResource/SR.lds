SECTIONS
{
  .SR_Table :
  {
    . = ALIGN(8);
    SR_Table_S = .;
    KEEP(*(.SR_0_0))
    KEEP(*(.SR_0_1))
    KEEP(*(.SR_0_2))
    KEEP(*(.SR_0_3))
    KEEP(*(.SR_0_4))
    KEEP(*(.SR_0_5))
    KEEP(*(.SR_0_6))
    KEEP(*(.SR_1_0))
    KEEP(*(.SR_1_1))
    KEEP(*(.SR_1_2))
    KEEP(*(.SR_1_3))
    KEEP(*(.SR_1_4))
    KEEP(*(.SR_1_5))
    KEEP(*(.SR_1_6))
    KEEP(*(.SR_2_0))
    KEEP(*(.SR_2_1))
    KEEP(*(.SR_2_2))
    KEEP(*(.SR_2_3))
    KEEP(*(.SR_2_4))
    KEEP(*(.SR_2_5))
    KEEP(*(.SR_2_6))
    KEEP(*(.SR_3_0))
    KEEP(*(.SR_3_1))
    KEEP(*(.SR_3_2))
    KEEP(*(.SR_3_3))
    KEEP(*(.SR_3_4))
    KEEP(*(.SR_3_5))
    KEEP(*(.SR_3_6))
    KEEP(*(.SR_4_0))
    KEEP(*(.SR_4_1))
    KEEP(*(.SR_4_2))
    KEEP(*(.SR_4_3))
    KEEP(*(.SR_4_4))
    KEEP(*(.SR_4_5))
    KEEP(*(.SR_4_6))
    KEEP(*(.SR_5_0))
    KEEP(*(.SR_5_1))
    KEEP(*(.SR_5_2))
    KEEP(*(.SR_5_3))
    KEEP(*(.SR_5_4))
    KEEP(*(.SR_5_5))
    KEEP(*(.SR_5_6))
    KEEP(*(.SR_6_0))
    KEEP(*(.SR_6_1))
    KEEP(*(.SR_6_2))
    KEEP(*(.SR_6_3))
    KEEP(*(.SR_6_4))
    KEEP(*(.SR_6_5))
    KEEP(*(.SR_6_6))
    SR_Table_E = .;
  }
}
